// -----------------------------------------------------------------------------
// Определение макро-констант для использования разных портов
// -----------------------------------------------------------------------------
#define work_port Serial        // work_port – порт для обмена данными с ПК (USB)
// Используется для ввода команд и отладки через Serial Monitor

#define debug_port Serial1      // debug_port – порт для обмена данными с управляющим устройством (например, внешним модулем)
// Используется для вывода служебных сообщений и отладочной информации

#define max_consuption_counter 5
// Если количество выполненных операций (consuption_counter) достигает этого значения, запускается автоматическая калибровка

// -----------------------------------------------------------------------------
// Определение пинов и параметров системы
// -----------------------------------------------------------------------------

#define SELMODE 12
// Пин для входа в режим отладки. Если при включении пин замкнут на GND, устройство запускается в режиме отладки

#define SDA 20
#define SCL 21
// Пины SDA и SCL для подключения I²C дисплея (LCD)

#define DTX A0      // Данные энкодера для оси X
#define CLKX A1     // Тактовый сигнал энкодера для оси X
#define DTY A2      // Данные энкодера для оси Y
#define CLKY A3     // Тактовый сигнал энкодера для оси Y
#define DTZ A4      // Данные энкодера для оси Z
#define CLKZ A5     // Тактовый сигнал энкодера для оси Z
#define BTN A6      // Пин для подключения кнопки, запускающей моторы в режиме отладки

#define DIRX 23     // Пин управления направлением мотора по оси X
#define PULX 25     // Пин импульсов для мотора по оси X
#define DIRY 27     // Пин управления направлением мотора по оси Y
#define PULY 29     // Пин импульсов для мотора по оси Y

#define KONCX 53    // Пин концевого выключателя для оси X
#define KONCY 51    // Пин концевого выключателя для оси Y

#define DX 5        // Количество шагов изменения координаты по оси X при щелчке энкодера
#define DY 5        // Количество шагов изменения координаты по оси Y при щелчке энкодера

#define MAXX 4060   // Максимальное значение координаты по оси X
#define MAXY 3000   // Максимальное значение координаты по оси Y
#define MAXZ 180    // Максимальное значение координаты по оси Z

#define CX 20       // Координата возврата по оси X после выполнения операции
#define CY 20       // Координата возврата по оси Y после выполнения операции

#define MULT 4        // Множитель для преобразования координат в число шагов (учёт микрошагов)
#define CALSP 1000    // Скорость моторов при калибровке (низкая скорость для точности)
#define WORKSP 4000   // Рабочая скорость моторов в обычном режиме

uint16_t NUM = 512;
// Количество ячеек памяти, где хранятся координаты. Из них выбирается нужная ячейка для перемещения

// -----------------------------------------------------------------------------
// Подключение необходимых библиотек
// -----------------------------------------------------------------------------

#include <Wire.h>                   // Для работы с I²C (LCD дисплей)
#include <Servo.h>                  // Для управления сервоприводом
#include "COORD.h"                  // Файл с массивами координат (например, Xmass, Ymass, Zmass)
#include <EncButton.h>              // Для работы с энкодерами и кнопками
#include <AccelStepper.h>           // Для управления шаговыми моторами
#include <LiquidCrystal_I2C.h>      // Для работы с LCD по I²C
// При необходимости можно подключить GyverIO для расширенного управления пинами

// -----------------------------------------------------------------------------
// Создание объектов для периферии
// -----------------------------------------------------------------------------

LiquidCrystal_I2C lcd(0x27, 16, 2);  // Объект LCD дисплея: адрес 0x27, 16 столбцов, 2 строки
AccelStepper stX(1, PULX, DIRX);      // Объект шагового мотора для оси X (режим драйвера 1)
AccelStepper stY(1, PULY, DIRY);      // Объект шагового мотора для оси Y (режим драйвера 1)
EncButton ebX(DTX, CLKX);             // Объект энкодера для оси X
EncButton ebY(DTY, CLKY);             // Объект энкодера для оси Y
EncButton ebZ(DTZ, CLKZ);             // Объект энкодера для оси Z
Servo myservo;                      // Объект для управления сервоприводом

long pos[3];
// Массив для хранения текущих координат: pos[0] – X, pos[1] – Y, pos[2] – Z

uint16_t targ;
// Переменная для хранения номера ячейки, из которой необходимо получить координаты

uint8_t consuption_counter;
// Счетчик выполненных операций для автоматической калибровки при достижении порога

// -----------------------------------------------------------------------------
// Функция toggleBit: переключает состояние указанного пина
// -----------------------------------------------------------------------------
void toggleBit(int pin) {
  int currentState = digitalRead(pin);  // Считываем текущее состояние пина
  digitalWrite(pin, !currentState);       // Записываем противоположное значение: HIGH ↔ LOW
}

// -----------------------------------------------------------------------------
// Функция runServo: плавно изменяет угол сервопривода до заданного значения
// Аргументы:
//   angle – целевой угол сервопривода,
//   per – задержка (в миллисекундах) между изменениями угла для плавного движения
// -----------------------------------------------------------------------------
void runServo(int angle, int per) {
  int b = myservo.read();                 // Считываем текущий угол сервопривода
  while (true) {
    if (b < angle)
      b++;                                // Если текущий угол меньше целевого, увеличиваем значение
    else if (b > angle)
      b--;                                // Если текущий угол больше целевого, уменьшаем значение
    else
      return;                             // Если угол достиг целевого значения, выходим из функции
    myservo.write(b);                     // Устанавливаем сервоприводу новое значение угла
    delay(per);                           // Задержка для обеспечения плавного движения
  }
}

// -----------------------------------------------------------------------------
// Функция setup: инициализация всех компонентов устройства (вызывается один раз при старте)
// -----------------------------------------------------------------------------
void setup() {
  consuption_counter = 0;                // Инициализируем счетчик выполненных операций
  pinMode(LED_BUILTIN, OUTPUT);            // Настраиваем встроенный светодиод как выход
  debug_port.begin(9600);                 // Инициализируем debug_port (Serial1) для отладочных сообщений
  debug_port.print("\r\n");               // Выводим переход на новую строку
  debug_port.print("Инициализация");      // Сообщение о начале инициализации
  work_port.begin(9600);                  // Инициализируем work_port (Serial) для обмена данными с ПК

  pinMode(SELMODE, INPUT_PULLUP);          // Настраиваем SELMODE с подтяжкой (режим отладки определяется состоянием этого пина)
  pinMode(KONCX, INPUT_PULLUP);            // Настраиваем концевой выключатель оси X с подтяжкой
  pinMode(KONCY, INPUT_PULLUP);            // Настраиваем концевой выключатель оси Y с подтяжкой
  pinMode(BTN, INPUT_PULLUP);              // Настраиваем кнопку (BTN) с подтяжкой

  debug_port.print(".");                 // Вывод точки для индикации прогресса инициализации

  // Настройка шаговых моторов: установка ускорения и рабочей скорости
  stX.setAcceleration(10000);
  stY.setAcceleration(10000);
  stX.setMaxSpeed(WORKSP);
  stY.setMaxSpeed(WORKSP);
  debug_port.print(".");

  // Подключение сервопривода: пин 4, начальное положение 100 градусов
  myservo.attach(4);
  myservo.write(100);
  debug_port.print(".");

  // Инициализация LCD и включение подсветки
  lcd.init();
  lcd.backlight();
  debug_port.print(".");

  // Если пин SELMODE замкнут (режим отладки), запускается функция settingMode()
  if (!digitalRead(SELMODE))
    settingMode();
  debug_port.print(".");

  // Выполняется калибровка: установка нулевой позиции с помощью функции setZero()
  setZero();

  // Перемещаем моторы в начальное положение, заданное координатами CX и CY, с учетом множителя MULT
  stX.moveTo(long(CX) * MULT);
  stY.moveTo(long(CY) * MULT);
  // Ждем, пока моторы закончат движение
  while (stX.run() || stY.run());

  // На LCD выводится приглашение для ввода команды
  lcd.setCursor(0, 0);
  lcd.print("Enter pos: ");

  // Отправляем через debug_port сообщение о готовности устройства
  debug_port.print("\r\n");
  debug_port.print("Устройство готово к работе");
  debug_port.print("\r\n");
}

// -----------------------------------------------------------------------------
// Функция loop: основной цикл обработки входящих команд и управления устройством
// -----------------------------------------------------------------------------
void loop() {
  // Ожидаем, пока в work_port (USB, отладка) накопится минимум 4 байта данных
  while (work_port.available() < 4) delay(10);

  // Считываем первый байт; если он не равен символу '$', команда игнорируется
  if (work_port.read() != '$')
    return;

  // Индикация получения команды: переключаем встроенный светодиод
  toggleBit(LED_BUILTIN);
  delay(10);

  targ = 0;                            // Обнуляем номер ячейки
  uint16_t buf = work_port.read();     // Считываем следующий байт и сохраняем его в buf

  // Цикл формирования числа (номера ячейки) из входящих данных
  while (work_port.available()) {
    buf = (buf << 8) | work_port.read();  // Сдвигаем buf на 8 бит влево и объединяем с новым байтом

    // Если получена последовательность символов CR+LF (0x0D0A), значит, команда завершена
    if (buf == 0x0D0A) {
      // Если номер ячейки корректен и не превышает допустимое количество ячеек
      if (targ && targ <= NUM) {
        // Извлекаем координаты для данной ячейки из памяти (используем массивы Xmass, Ymass, Zmass из COORD.h)
        pos[0] = pgm_read_word(&Xmass[targ - 1]);
        pos[1] = pgm_read_word(&Ymass[targ - 1]);
        pos[2] = pgm_read_word(&Zmass[targ - 1]);

        // Отправляем через work_port сообщение о начале выполнения команды
        work_port.print("$1\n");
        // Выводим через debug_port информацию о том, из какой ячейки выдаются координаты
        debug_port.print("Выдать из ячейки: ");
        debug_port.println(targ);
        // Запускаем выполнение команды перемещения
        runToPos();
      }
    }
    else
      toggleBit(LED_BUILTIN);   // Если полученный буфер не равен CR+LF, индицируем ошибку переключением светодиода

    // Формирование номера ячейки: умножаем targ на 10 и прибавляем числовое значение текущего байта (ASCII)
    targ *= 10;
    targ += (buf >> 8) - 48;  // Вычитание 48 преобразует ASCII-код цифры в число
  }
}

// -----------------------------------------------------------------------------
// Функция runToPos: осуществляет перемещение моторов и сервопривода согласно извлеченным координатам
// -----------------------------------------------------------------------------
void runToPos() {
  // Перемещаем моторы по осям X и Y к заданным координатам
  stX.moveTo(pos[0] * MULT);
  stY.moveTo(pos[1] * MULT);
  // Ждем завершения движения моторов
  while (stX.run() || stY.run());

  delay(300);  // Задержка перед началом работы сервопривода

  // Плавное перемещение сервопривода к позиции, указанной в pos[2] (с задержкой 3 мс между шагами)
  runServo(pos[2], 3);
  delay(500);

  // Серия быстрых переключений сервопривода для имитации вибрации или корректировки позиции
  for (byte i = 0; i < 5; i++) {
    myservo.write(15);
    delay(50);
    myservo.write(30);
    delay(50);
  }

  // Перемещение сервопривода для выхода из "лотка": перемещаем до угла 100 с задержкой 10 мс
  runServo(100, 10);
  delay(500);

  // Возвращение моторов в начальное положение (координаты CX, CY)
  stX.moveTo(long(CX) * MULT);
  stY.moveTo(long(CY) * MULT);
  while (stX.run() || stY.run());

  // Перемещение сервопривода для "сброса": быстро перемещаем до угла 180 (с задержкой 1 мс)
  runServo(180, 1);
  delay(300);

  // Серия быстрых переключений сервопривода для имитации процедуры сброса (чередование углов 110 и 180)
  for (byte i = 0; i < 5; i++) {
    myservo.write(110);
    delay(50);
    myservo.write(180);
    delay(50);
  }

  // Возвращаем сервопривод в положение 100, что является конечным состоянием
  runServo(100, 4);

  // Отправляем через work_port сообщение о завершении команды "$2\n"
  work_port.print("$2\n");
  // Выводим сообщение об успешном выполнении через debug_port
  debug_port.print("Исполнено.");
  debug_port.print("\r\n");

  // Автоматическая калибровка: если счетчик операций достиг порогового значения, запускается setZero()
  if (consuption_counter >= max_consuption_counter)  {
    debug_port.print("Авто калибровка запущена.");
    debug_port.print("\r\n");
    setZero();
    consuption_counter = 0;
  }
  else {
    consuption_counter++;
  }
}

// -----------------------------------------------------------------------------
// Функция setZero: выполняет калибровку устройства, устанавливая нулевую позицию
// -----------------------------------------------------------------------------
void setZero() {
  debug_port.print("\r\n");
  debug_port.print("Начали установку нуля");
  bool bX, bY;  // Флаги состояния концевых выключателей для осей X и Y

  // Устанавливаем низкую скорость (CALSP) для точной калибровки
  stX.setMaxSpeed(CALSP);
  stY.setMaxSpeed(CALSP);

  // Задаем движение моторов в очень отрицательное направление, чтобы гарантированно достичь концевиков
  stX.moveTo(-9999999);
  stY.moveTo(-9999999);
  debug_port.print(".");

  // Цикл опроса: выполняется, пока хотя бы один из концевых выключателей не сработает
  do {
    if (bX) stX.run();  // Если для оси X еще не достигнут концевик, продолжаем движение
    if (bY) stY.run();  // Если для оси Y еще не достигнут концевик, продолжаем движение
    delay(1);           // Небольшая задержка для стабильности работы
    bX = digitalRead(KONCX);  // Считываем состояние концевого выключателя для оси X
    bY = digitalRead(KONCY);  // Считываем состояние концевого выключателя для оси Y
  } while (bX || bY);

  debug_port.print(".");
  // После срабатывания концевиков сбрасываем позицию моторов в 0
  stX.setCurrentPosition(0);
  stY.setCurrentPosition(0);
  debug_port.print(".");

  // Восстанавливаем рабочую скорость для дальнейшей эксплуатации
  stX.setMaxSpeed(WORKSP);
  stY.setMaxSpeed(WORKSP);
  debug_port.print("Ок");
}

// -----------------------------------------------------------------------------
// Функция updScreen: обновляет информацию о координатах на LCD дисплее для заданной оси
// Аргумент n: номер оси (0 – X, 1 – Y, 2 – Z)
// -----------------------------------------------------------------------------
void updScreen(byte n) {
  lcd.setCursor(2, n);  // Устанавливаем курсор в столбце 2 на строке, соответствующей оси n
  lcd.print(" ");       // Очищаем область вывода, печатая пробел
  // Добавляем пробелы для выравнивания вывода числовых значений
  if (pos[n] < 1000) lcd.print(" ");
  if (pos[n] < 100) lcd.print(" ");
  if (pos[n] < 10) lcd.print(" ");
  lcd.print(pos[n]);    // Выводим значение координаты для данной оси
}

// -----------------------------------------------------------------------------
// Функция settingMode: режим отладки для ручной настройки параметров и тестирования
// -----------------------------------------------------------------------------
void settingMode() {
  debug_port.print("\r\n");
  debug_port.print("Включён режим отладки");

  // Отображаем заголовки осей на LCD
  lcd.setCursor(0, 0);
  lcd.print("X ");
  lcd.setCursor(0, 1);
  lcd.print("Y ");
  lcd.setCursor(0, 2);
  lcd.print("Z ");

  // Выводим текущие значения координат на LCD
  updScreen(0);
  updScreen(1);
  updScreen(2);
  debug_port.print(".");

  // Калибровка нулевой позиции в режиме отладки
  setZero();
  debug_port.print(".");

  // Бесконечный цикл, позволяющий вводить номер ячейки и изменять координаты через work_port
  while (true) {
    if (work_port.available()) {                // Если есть данные с work_port (USB, отладка)
      int p = work_port.parseInt();             // Считываем число – номер ячейки
      work_port.println(p);                     // Выводим считанное число для обратной связи
      if (p && p <= NUM) {                      // Если число корректное
        // Извлекаем координаты для заданной ячейки из памяти (массивы Xmass, Ymass, Zmass из COORD.h)
        pos[0] = pgm_read_word(&Xmass[p - 1]);
        pos[1] = pgm_read_word(&Ymass[p - 1]);
        pos[2] = pgm_read_word(&Zmass[p - 1]);
        updScreen(0);
        updScreen(1);
        runToPos();                           // Выполняем движение к выбранной позиции
      }
    }
    debug_port.print(".");  // Вывод точки для индикации активности

    // Опрос энкодеров для ручного изменения координат
    ebX.tick();
    ebY.tick();
    ebZ.tick();
    debug_port.print(".");

    // Если энкодер оси X поворачивается влево, уменьшаем pos[0]
    if (ebX.left() && pos[0]) {
      pos[0] -= DX;
      updScreen(0);
    }
    debug_port.print(".");
    // Если энкодер оси X поворачивается вправо и pos[0] меньше MAXX, увеличиваем pos[0]
    if (ebX.right() && pos[0] < MAXX) {
      pos[0] += DX;
      updScreen(0);
    }
    debug_port.print(".");
    // Аналогично для оси Y
    if (ebY.left() && pos[1]) {
      pos[1] -= DY;
      updScreen(1);
    }
    debug_port.print(".");
    if (ebY.right() && pos[1] < MAXY) {
      pos[1] += DY;
      updScreen(1);
    }
    debug_port.print(".");
    // Для оси Z: если вращается влево, уменьшаем pos[2]; если вращается вправо и pos[2] меньше MAXZ, увеличиваем pos[2]
    if (ebZ.left() && pos[2]) {
      pos[2]--;
      updScreen(2);
    }
    debug_port.print(".");
    if (ebZ.right() && pos[2] < MAXZ) {
      pos[2]++;
      updScreen(2);
    }
    debug_port.print(".");

    // Если нажата кнопка (BTN), выполняется последовательность движения:
    // перемещение моторов, плавное движение сервопривода и имитация операции
    if (!digitalRead(BTN)) {
      stX.moveTo(pos[0] * MULT);
      stY.moveTo(pos[1] * MULT);
      while (stX.run() || stY.run());
      delay(300);
      runServo(pos[2], 4);
      delay(1500);
      runServo(110, 4);
      delay(300);
    }
    debug_port.print(".");
  }
  debug_port.print("Ок");
}